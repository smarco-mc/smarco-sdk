## conf/layer.conf
```bitbake
# We have a conf and classes directory, add to BBPATH
BBPATH =. "${LAYERDIR}:"

# We have recipes-* directories, add to BBFILES
BBFILES += "${LAYERDIR}/recipes-*/*/*.bb \
            ${LAYERDIR}/recipes-*/*/*.bbappend"

BBFILE_COLLECTIONS += "smarco-sdk"
BBFILE_PATTERN_smarco-sdk = "^${LAYERDIR}/"
BBFILE_PRIORITY_smarco-sdk = "9"

# This should only be incremented on significant changes that will
# cause compatibility issues with other layers
LAYERVERSION_smarco-sdk = "1"

LAYERDEPENDS_smarco-sdk = "core"
LAYERDEPENDS_smarco-sdk += "riscv-layer"
LAYERDEPENDS_smarco-sdk += "meta-smarco"
LAYERDEPENDS_smarco-sdk += "openembedded-layer"
LAYERDEPENDS_smarco-sdk += "networking-layer"
LAYERDEPENDS_smarco-sdk += "meta-python"
LAYERDEPENDS_smarco-sdk += "multimedia-layer"
LAYERDEPENDS_smarco-sdk += "filesystems-layer"
LAYERDEPENDS_smarco-sdk += "gnome-layer"
LAYERDEPENDS_smarco-sdk += "xfce-layer"
LAYERDEPENDS_smarco-sdk += "clang-layer"


LAYERSERIES_COMPAT_smarco-sdk = "kirkstone"

INSANE_SKIP:append:pn-jq:riscv64 = " textrel"
```
